## west.yml
```yaml
manifest:

  projects:
    - name: lib_xcore_math
      url: https://github.com/xmos/lib_xcore_math
      revision: v2.1.1
      path: xmath_walkthrough/lib_xcore_math
    - name: xmos_cmake_toolchain
      url: https://github.com/xmos/xmos_cmake_toolchain
      revision: main
      path: xmos_cmake_toolchain
    - name: xscope_fileio
      url: https://github.com/astewart-xmos/xscope_fileio
      revision: master
      path: xmath_walkthrough/xscope_fileio
```
